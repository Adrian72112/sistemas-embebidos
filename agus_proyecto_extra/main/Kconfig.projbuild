## agus_proyecto_extra/main/Kconfig.projbuild
```kconfig
menu "Example Configuration"

    config WIFI_SSID
        string "WiFi SSID"
        default "Yosoytuwifi"

    config WIFI_PASS
        string "WiFi Password"
        default "4dejulio"

    config MQTT_URI
        string "MQTT Broker URI"
        default "mqtt://broker.hivemq.com"

    config MQTT_TOPIC
        string "MQTT Topic"
        default "/kaluga/test"

endmenu
```

## mqtt/components/wifi_connection/Kconfig.projbuild
```kconfig
menu "WiFi Connection Configuration"

    config WIFI_SSID
        string "WiFi SSID"
        default "YourWiFiSSID"
        help
            SSID (network name) for the device to connect to.

    config WIFI_PASSWORD
        string "WiFi Password"
        default "YourWiFiPassword"
        help
            WiFi password (WPA or WPA2) for the device to use.
            Can be left blank if the network has no security set.

    config WIFI_CONN_MAX_RETRY
        int "Maximum retry"
        default 6
        help
            Set the Maximum retry to avoid station reconnecting to the AP unlimited when the AP is really inexistent.

    choice WIFI_SCAN_METHOD
        prompt "WiFi Scan Method"
        default WIFI_SCAN_METHOD_ALL_CHANNEL
        help
            WiFi scan method:
            - Fast scan: scan will end after find SSID match AP
            - All channel scan: scan will end after scan all the channel

        config WIFI_SCAN_METHOD_FAST
            bool "Fast scan"
        config WIFI_SCAN_METHOD_ALL_CHANNEL
            bool "All channel scan"
    endchoice

    config WIFI_SCAN_RSSI_THRESHOLD
        int "WiFi Scan RSSI Threshold"
        range -127 0
        default -127
        help
            The minimum rssi to accept in the scan mode

    choice WIFI_AUTH_MODE
        prompt "WiFi Authentication Mode"
        default WIFI_AUTH_OPEN
        help
            WiFi authentication mode

        config WIFI_AUTH_OPEN
            bool "Open"
        config WIFI_AUTH_WEP
            bool "WEP"
        config WIFI_AUTH_WPA_PSK
            bool "WPA PSK"
        config WIFI_AUTH_WPA2_PSK
            bool "WPA2 PSK"
        config WIFI_AUTH_WPA_WPA2_PSK
            bool "WPA/WPA2 PSK"
        config WIFI_AUTH_WPA2_ENTERPRISE
            bool "WPA2 Enterprise"
        config WIFI_AUTH_WPA3_PSK
            bool "WPA3 PSK"
        config WIFI_AUTH_WPA2_WPA3_PSK
            bool "WPA2/WPA3 PSK"
        config WIFI_AUTH_WAPI_PSK
            bool "WAPI PSK"
    endchoice

    choice WIFI_CONNECT_AP_SORT_METHOD
        prompt "WiFi Connect AP Sort Method"
        default WIFI_CONNECT_AP_BY_SIGNAL
        help
            WiFi connect AP sort method

        config WIFI_CONNECT_AP_BY_SIGNAL
            bool "By Signal"
        config WIFI_CONNECT_AP_BY_SECURITY
            bool "By Security"
    endchoice

    config CONNECT_IPV4
        bool "Connect using IPv4"
        default y
        help
            Connect using IPv4

    config CONNECT_IPV6
        bool "Connect using IPv6"
        default y
        help
            Connect using IPv6

    choice CONNECT_IPV6_PREF
        prompt "IPv6 Address Preference"
        depends on CONNECT_IPV6
        default CONNECT_IPV6_PREF_LOCAL_LINK
        help
            Select which IPv6 address the device will report to use

        config CONNECT_IPV6_PREF_LOCAL_LINK
            bool "Local Link"
        config CONNECT_IPV6_PREF_GLOBAL
            bool "Global"
        config CONNECT_IPV6_PREF_SITE_LOCAL
            bool "Site Local"
        config CONNECT_IPV6_PREF_UNIQUE_LOCAL
            bool "Unique Local"
    endchoice

endmenu
```

## mqtt/sdkconfig.defaults
```kconfig
# WiFi Connection Configuration
CONFIG_WIFI_SSID="YourWiFiSSID"
CONFIG_WIFI_PASSWORD="YourWiFiPassword"
CONFIG_WIFI_CONN_MAX_RETRY=6
CONFIG_WIFI_SCAN_METHOD_ALL_CHANNEL=y
CONFIG_WIFI_SCAN_RSSI_THRESHOLD=-127
CONFIG_WIFI_AUTH_OPEN=y
CONFIG_WIFI_CONNECT_AP_BY_SIGNAL=y
CONFIG_CONNECT_IPV4=y
CONFIG_CONNECT_IPV6=y
CONFIG_CONNECT_IPV6_PREF_LOCAL_LINK=y

# MQTT Configuration
CONFIG_MQTT_BROKER_URL="mqtt://broker.hivemq.com"

# ESP-MQTT Configuration
CONFIG_MQTT_PROTOCOL_5=y
```

## project-extra-final/main/Kconfig.projbuild
```kconfig
menu "Configuración del Proyecto Extra"

config WIFI_SSID
    string "WiFi SSID"
    default "TuSSID"

config WIFI_PASSWORD
    string "WiFi Password"
    default "TuPassword"

config MQTT_BROKER_URI
    string "MQTT Broker URI"
    default "mqtt://broker.hivemq.com:1883"

config MQTT_TOPIC
    string "MQTT Topic"
    default "/kaluga/test"

endmenu
```

## project-extra/main/Kconfig.projbuild
```kconfig
menu "Example Configuration"

    config BROKER_URL
        string "Broker URL"
        default "mqtt://mqtt.eclipseprojects.io"
        help
            URL del broker MQTT que se usará como valor inicial en mqtt_uri.
            Este valor se puede sobreescribir luego con el comando !broker por consola.

endmenu
```

## proyecto-final/sdkconfig.defaults
```kconfig
# Configuraciones por defecto para el proyecto
# Estas configuraciones se aplicarán automáticamente

# Flash de 4MB (ESP32-S2 Kaluga Kit tiene 4MB)
CONFIG_ESPTOOLPY_FLASHSIZE_4MB=y
CONFIG_ESPTOOLPY_FLASHSIZE="4MB"

# Tabla de particiones personalizada
CONFIG_PARTITION_TABLE_CUSTOM=y
CONFIG_PARTITION_TABLE_CUSTOM_FILENAME="partitions.csv"
CONFIG_PARTITION_TABLE_FILENAME="partitions.csv"

# WiFi por defecto
CONFIG_ESP_WIFI_SOFTAP_SUPPORT=y

# Configuraciones de logging
CONFIG_LOG_DEFAULT_LEVEL_INFO=y
CONFIG_LOG_DEFAULT_LEVEL=3

# HTTP Server
CONFIG_HTTPD_MAX_REQ_HDR_LEN=1024
CONFIG_HTTPD_MAX_URI_LEN=512

# MQTT
CONFIG_MQTT_PROTOCOL_5=y
CONFIG_MQTT_TRANSPORT_SSL=y
CONFIG_MQTT_TRANSPORT_WEBSOCKET=y
```

## vamoyvamo/main/Kconfig.projbuild
```kconfig
menu "Example Configuration"

    config BROKER_URL
        string "Broker URL"
        default "mqtt://mqtt.eclipseprojects.io:1883"
        help
            URL of the broker to connect to

    config BROKER_URL_FROM_STDIN
        bool "Set broker URL from stdin"  # Agregué el texto que aparece en menuconfig
        default n       
    
    config WIFI_SSID
        string "WiFi SSID"
        default "Yosoytuwifi"
        help
            SSID of the WiFi network to connect to
    config WIFI_PASSWORD
        string "WiFi Password"  
        default "Yosoytu1234"
        help    
            Password for the WiFi network
endmenu
```
